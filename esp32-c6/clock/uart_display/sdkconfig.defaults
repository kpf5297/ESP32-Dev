## esp32-c6/clock/uart_display/sdkconfig.defaults
```kconfig
CONFIG_SPIRAM=y
CONFIG_SPIRAM_MODE_OCT=y
CONFIG_SPIRAM_SPEED_80M=y

CONFIG_LV_USE_USER_DATA=y
CONFIG_LV_USE_CHART=y
# CONFIG_LV_USE_PERF_MONITOR is not set
# Enable Montserrat 40 used by SquareLine export
CONFIG_LV_FONT_MONTSERRAT_40=y

CONFIG_ESPTOOLPY_FLASHSIZE_4MB=y
CONFIG_PARTITION_TABLE_CUSTOM=y
```
